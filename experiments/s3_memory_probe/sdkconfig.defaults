## experiments/s3_memory_probe/sdkconfig.defaults
```kconfig
CONFIG_IDF_TARGET="esp32s3"
CONFIG_ESPTOOLPY_FLASHSIZE_16MB=y
CONFIG_SPIRAM=y
CONFIG_SPIRAM_MODE_OCT=y
CONFIG_SPIRAM_SPEED_80M=y
CONFIG_ESP_DEFAULT_CPU_FREQ_MHZ_240=y
CONFIG_COMPILER_OPTIMIZATION_PERF=y
CONFIG_ESP_MAIN_TASK_STACK_SIZE=8192
# CONFIG_FREERTOS_UNICORE is not set
# CONFIG_ESP_WIFI_IRAM_OPT is not set
# CONFIG_ESP_WIFI_EXTRA_IRAM_OPT is not set
# CONFIG_ESP_WIFI_RX_IRAM_OPT is not set
# CONFIG_ESP_WIFI_SLP_IRAM_OPT is not set
# CONFIG_ESP_PHY_IRAM_OPT is not set
```

## experiments/s3_queue_owner_probe/sdkconfig.defaults
```kconfig
CONFIG_IDF_TARGET="esp32s3"
CONFIG_ESPTOOLPY_FLASHSIZE_16MB=y
CONFIG_ESP_DEFAULT_CPU_FREQ_MHZ_240=y
CONFIG_COMPILER_OPTIMIZATION_PERF=y
CONFIG_SPI_MASTER_IN_IRAM=y
CONFIG_SPI_MASTER_ISR_IN_IRAM=y
CONFIG_SPIRAM=y
CONFIG_SPIRAM_MODE_OCT=y
CONFIG_SPIRAM_SPEED_80M=y
CONFIG_SPIRAM_USE_MALLOC=y
CONFIG_SPIRAM_MALLOC_RESERVE_INTERNAL=4096
CONFIG_FREERTOS_TASK_CREATE_ALLOW_EXT_MEM=y
```

## experiments/s3_raw_probe/main/Kconfig.projbuild
```kconfig
menu "Raw receiver diagnostic"
config RAW_SPI_LOCK_ISR_IN_IRAM
    bool "Place SPI bus lock ISR helpers in IRAM"
    default n
    select ESP_SPI_BUS_LOCK_ISR_FUNCS_IN_IRAM
    help
        With heap functions in Flash, pinned IDF 5.5.1 reports an unmet
        SPI_MASTER_ISR_IN_IRAM dependency and does not select these helpers. This option closes their known Flash placement gap only;
        it does not prove the complete interrupt call graph cache safe.
endmenu
```
